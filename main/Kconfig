## main/Kconfig
```kconfig
menu "Example configuration"

    config USE_HTTPS_DOWNLOAD_IMG
        bool "Download the image using HTTPS"
        default y
        help
            When USE_HTTPS_DOWNLOAD_IMG is enabled, download the image using the HTTPS URL;
            otherwise, download the image using the HTTP URL.

    config OTA_PROGRESS_REPORT_THRESHOLD
        int "Progress Report Threshold (%)"
        range 1 100
        default 10
        help
            This option sets the threshold for reporting progress during the OTA upgrade.
            The progress will be reported every 'OTA_PROGRESS_REPORT_THRESHOLD' percentage of the upgrade process.

    config OTA_SUPPORT_PERIODIC_CHECK
        bool "OTA support periodic check for updates"
        default y
        help
            When OTA_SUPPORT_PERIODIC_CHECK is enabled, the system will periodically check for available updates.
            If updates are available, the system will notify the user or automatically download the updates.
            Otherwise, the system will not perform any periodic check for updates.

    config OTA_UPGRADE_PERIOD
        int "OTA Upgrade Period (seconds)"
        range 60 86400
        default 60
        help
            This option sets the period in seconds for how often the system should check for an OTA upgrade.
            The system will check for a new update every 'OTA_UPGRADE_PERIOD' seconds.

    config OTA_MQTTS_RECONNECT_TIMEOUT
        int "MQTT Reconnect Timeout (seconds)"
        range 10 3600
        default 10
        help
            Timeout in seconds for MQTT reconnection during OTA. Default is 10 seconds.

endmenu
```

## webnet/Kconfig
```kconfig
menuconfig COMPONENT_WEBNET_ENABLED
    bool "Webnet"
    default n
    select COMPONENT_WIFI_ENABLED
    help
        Select this option to enable Webnet and show the submenu.

if COMPONENT_WEBNET_ENABLED

    config WEBNET_PORT
        int "Server listen port"
        default 80
        range 0 65535

    config WEBNET_CONN_MAX
        int "Maximum number of server connections"
        default 16
        range 1 100

    config WEBNET_FS
        bool "FS: Enable FS"
        default n

    if WEBNET_FS = y

        config WEBNET_ROOT
            string "Server root directory"
            default "/"

    endif

    if WEBNET_FS = n

        config WEBNET_FS_IN_RAM_SIZE
            int "file in ram size"
            default 10240

    endif

    menu "Select supported modules"

        config WEBNET_USING_LOG
            bool "LOG: Enable output log support"
            default n

        config WEBNET_USING_AUTH
            bool "AUTH: Enable basic HTTP authentication support"
            default n

        config WEBNET_USING_CGI
            bool "CGI: Enable Common Gateway Interface support"
            default y

        config WEBNET_USING_ASP
            bool "ASP: Enable Active Server Pages support"
            default n

        config WEBNET_USING_SSI
            bool "SSI: Enable Server Side Includes support"
            default y

        config WEBNET_USING_INDEX
            bool "INDEX: Enable list all the file in the directory support"
            default n

        config WEBNET_USING_ALIAS
            bool "ALIAS: Enable alias support"
            default n

#            config WEBNET_USING_DAV
#                bool "DAV: Enable Web-based Distributed Authoring and Versioning support"
#                default n

        config WEBNET_USING_UPLOAD
            bool "UPLOAD: Enable upload file support"
            default y
        
        if WEBNET_VFS = y

            config WEBNET_USING_GZIP
                bool "GZIP: Enable compressed file support by GZIP"
                default n
        
        endif

        config WEBNET_CACHE_LEVEL
            depends on WEBNET_FS
            int "CACHE: Configure cache level(0:disable 1:use Last-Modified 2:use Cache-Control)"
            default 0
            range 0 2

        if WEBNET_CACHE_LEVEL = 2

            config WEBNET_CACHE_MAX_AGE
                int "Cache-Control time in seconds"
                default 1800

        endif

    endmenu

endif
```
